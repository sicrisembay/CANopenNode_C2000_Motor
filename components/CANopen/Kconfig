## components/CANopen/Kconfig
```kconfig
menuconfig USE_CANOPEN
    bool "CANopen"
    default n

    if USE_CANOPEN
        menu "Task Property"
            menu "CO main"
                config CANOPEN_MAIN_TASK_PRIORITY
                    int "Priority"
                    default 1
                config CANOPEN_MAIN_TASK_STACK
                    int "Stack"
                    default 640
                config CANOPEN_MAIN_INTERVAL_MS
                    int "Execution Interval (ms)"
                    default 10
            endmenu
            menu "CO timer"
                config CANOPEN_TIMER_TASK_PRIORITY
                    int "Priority"
                    default 2
                config CANOPEN_TIMER_TASK_STACK
                    int "Stack"
                    default 512
                config CANOPEN_TIMER_INTERVAL_MS
                    int "Execution Interval (ms)"
                    default 5
            endmenu
        endmenu # "Task Property"

        menu "CAN Configurtion"
            choice
                prompt "CAN Peripheral"
                config CANOPEN_USE_CAN_A
                    bool "CAN-A"
                config CANOPEN_USE_CAN_B
                    bool "CAN-B"
            endchoice

            if (CANOPEN_USE_CAN_A || CANOPEN_USE_CAN_B)
                choice
                    prompt "TX GPIO"
                    default CANOPEN_TX_GPIO19 if CANOPEN_USE_CAN_A
                    default CANOPEN_TX_GPIO20 if CANOPEN_USE_CAN_B
                    config CANOPEN_TX_GPIO19
                        depends on CANOPEN_USE_CAN_A
                        bool "GPIO19"
                    config CANOPEN_TX_GPIO31
                        depends on CANOPEN_USE_CAN_A
                        bool "GPIO31"
                    config CANOPEN_TX_GPIO8
                        depends on CANOPEN_USE_CAN_B
                        bool "GPIO8"
                    config CANOPEN_TX_GPIO12
                        depends on CANOPEN_USE_CAN_B
                        bool "GPIO12"
                    config CANOPEN_TX_GPIO16
                        depends on CANOPEN_USE_CAN_B
                        bool "GPIO16"
                    config CANOPEN_TX_GPIO20
                        depends on CANOPEN_USE_CAN_B
                        bool "GPIO20"
                endchoice

                choice
                    prompt "RX GPIO"
                    default CANOPEN_RX_GPIO18 if CANOPEN_USE_CAN_A
                    default CANOPEN_RX_GPIO21 if CANOPEN_USE_CAN_B
                    config CANOPEN_RX_GPIO18
                        depends on CANOPEN_USE_CAN_A
                        bool "GPIO18"
                    config CANOPEN_RX_GPIO30
                        depends on CANOPEN_USE_CAN_A
                        bool "GPIO30"
                    config CANOPEN_RX_GPIO10
                        depends on CANOPEN_USE_CAN_B
                        bool "GPIO10"
                    config CANOPEN_RX_GPIO13
                        depends on CANOPEN_USE_CAN_B
                        bool "GPIO13"
                    config CANOPEN_RX_GPIO17
                        depends on CANOPEN_USE_CAN_B
                        bool "GPIO17"
                    config CANOPEN_RX_GPIO21
                        depends on CANOPEN_USE_CAN_B
                        bool "GPIO21"
                endchoice

                menu "Supported Bit Rate"
                    config CANOPEN_BITRATE_20KBPS
                        bool "20 kbps"
                        default y
                    config CANOPEN_BITRATE_50KBPS
                        bool "50 kbps"
                        default y
                    config CANOPEN_BITRATE_125KBPS
                        bool "125 kbps"
                        default y
                    config CANOPEN_BITRATE_250KBPS
                        bool "250 kbps"
                        default y
                    config CANOPEN_BITRATE_500KBPS
                        bool "500 kbps"
                        default y
                    config CANOPEN_BITRATE_1000KBPS
                        bool "1000 kbps"
                        default y
                endmenu # "Supported Bit Rate"

                choice
                    prompt "Default Bit Rate"
                    default CANOPEN_DEFAULT_BITRATE_1000KBPS
                    config CANOPEN_DEFAULT_BITRATE_20KBPS
                        depends on CANOPEN_BITRATE_20KBPS
                        bool "20 kbps"
                    config CANOPEN_DEFAULT_BITRATE_50KBPS
                        depends on CANOPEN_BITRATE_50KBPS
                        bool "50 kbps"
                    config CANOPEN_DEFAULT_BITRATE_125KBPS
                        depends on CANOPEN_BITRATE_125KBPS
                        bool "125 kbps"
                    config CANOPEN_DEFAULT_BITRATE_250KBPS
                        depends on CANOPEN_BITRATE_250KBPS
                        bool "250 kbps"
                    config CANOPEN_DEFAULT_BITRATE_500KBPS
                        depends on CANOPEN_BITRATE_500KBPS
                        bool "500 kbps"
                    config CANOPEN_DEFAULT_BITRATE_1000KBPS
                        depends on CANOPEN_BITRATE_1000KBPS
                        bool "1000 kbps"
                endchoice # "Default Bit Rate"

                config CANOPEN_DEFAULT_BITRATE
                    int
                    default 20 if CANOPEN_DEFAULT_BITRATE_20KBPS
                    default 50 if CANOPEN_DEFAULT_BITRATE_50KBPS
                    default 125 if CANOPEN_DEFAULT_BITRATE_125KBPS
                    default 250 if CANOPEN_DEFAULT_BITRATE_250KBPS
                    default 500 if CANOPEN_DEFAULT_BITRATE_500KBPS
                    default 1000 if CANOPEN_DEFAULT_BITRATE_1000KBPS
                    default 1000
            endif
        endmenu # "CAN Configurtion"

        menu "CANopen Configuration"
            config CANOPEN_DEFAULT_NODEID
                hex "Node ID"
                range 0x01 0xFF
                default 0xFF
            config CANOPEN_LSS_SLAVE_ENABLE
                bool "LSS Slave"
                default y
            menuconfig CANOPEN_TIME_ENABLE
                bool "Timestamp Protocol"
                default y
                if CANOPEN_TIME_ENABLE
                    config CANOPEN_TIME_PRODUCER
                        bool "Enable Time Producer"
                        default n
                    config CANOPEN_TIME_PRODUCER_INTERVAL_MS
                        depends on CANOPEN_TIME_PRODUCER
                        int "Time producer interval (ms)"
                        default 10000
                endif # CANOPEN_TIME_ENABLE
            menuconfig CANOPEN_SYNC_ENABLE
                bool "Sync Protocol"
                default y
                if CANOPEN_SYNC_ENABLE
                    config CANOPEN_SYNC_PRODUCER
                        bool "Enable Sync Producer"
                        default n
                endif # CANOPEN_SYNC_ENABLE
            config CANOPEN_FIRST_HB_TIME
                int "First Heartbeat Time (ms)"
                default 500
            config CANOPEN_SDO_SRV_TIMEOUT
                int "SDO Server Timeout (ms)"
                default 1000
            config CANOPEN_SDO_CLIENT_TIMEOUT
                int "SDO Client Timeout (ms)"
                default 500
        endmenu # "CANopen Configuration"
    endif # USE_CANOPEN
```

## components/Kconfig
```kconfig
menu "Components"
  rsource "board_support/Kconfig"

  menu "QPC Configuration"
    menu "Memory Pool"
      menu "Small Memory Pool"
        config QPC_SMALL_MEMPOOL_ENTRY_COUNT
          int "Count"
          default 32
      endmenu
      menu "Medium Memory Pool"
        config QPC_MEDIUM_MEMPOOL_ENTRY_SIZE
          int "Size"
          default 16
        config QPC_MEDIUM_MEMPOOL_ENTRY_COUNT
          int "Count"
          default 32
      endmenu
      menu "Large Memory Pool"
        config QPC_LARGE_MEMPOOL_ENTRY_SIZE
          int "Size"
          default 64
        config QPC_LARGE_MEMPOOL_ENTRY_COUNT
          int "Count"
          default 32
      endmenu
    endmenu # Memory Pool
    menuconfig QPC_QSPY_ENABLE
      bool "Q-Spy"
      default y
      if QPC_QSPY_ENABLE
          choice
              prompt "Communication Channel"
              config QSPY_USE_UART_A
                  depends on ENABLE_UARTA
                  bool "UART-A"
              config QSPY_USE_UART_B
                  depends on ENABLE_UARTB
                  bool "UART-B"
              config QSPY_USE_UART_C
                  depends on ENABLE_UARTC
                  bool "UART-A"
          endchoice
  
          config QPSY_WORKER_TASK_PRIORITY
              int "Priority"
              default 1
          config QSPY_WORKER_STACK_SIZE
              int "Stack Size"
              default 512
          config QSPY_TX_BUFFER_SIZE
              int "Tx Size"
              default 256
          config QSPY_RX_BUFFER_SIZE
              int "Rx Size"
              default 256
          config QSPY_RX_TIMEOUT_MS
              int "Rx Timeout (millisecond)"
              default 2
      endif
  endmenu # QPC Configuration
endmenu #"Components"
```

## components/board_support/Kconfig
```kconfig
menu "Board Support"

    choice
        prompt "Crystal Frequency"
        default CRYSTAL_30MHZ
        config CRYSTAL_20MHZ
            bool "20MHz"
        config CRYSTAL_30MHZ
            bool "30MHz"
    endchoice

    choice
        prompt "Core Frequency"
        default CORE_FREQ_150MHZ
        config CORE_FREQ_100MHZ
            depends on CRYSTAL_20MHZ
            bool "100MHz"
        config CORE_FREQ_150MHZ
            bool "150MHz"
    endchoice

    config SYSTEM_FREQ_MHZ
        int
        default 100 if CORE_FREQ_100MHZ
        default 150 if CORE_FREQ_150MHZ

rsource "uart/Kconfig"
rsource "epwm/Kconfig"
rsource "adc/Kconfig"

endmenu # Board Support
```

## components/board_support/adc/Kconfig
```kconfig
menuconfig USE_ADC
    bool "ADC"
    default y

    if USE_ADC
        menu "Channel Configuration"
            config ADC_IA
                int "PhaseA Current"
                range -1 15
                default 11
            config ADC_IB
                int "PhaseB Current"
                range -1 15
                default 13
            config ADC_IC
                int "PhaseC Current"
                range -1 15
                default 5
            config ADC_VA
                int "PhaseA Voltage"
                range -1 15
                default 15
            config ADC_VB
                int "PhaseB Voltage"
                range -1 15
                default 14
            config ADC_VC
                int "PhaseC Voltage"
                range -1 15
                default 12
            config ADC_VBUS
                int "Bus Voltage"
                range -1 15
                default 7
        endmenu # "Channel Configuration"
        config FLOAT_VALUE_BASE_BUS_VOLTAGE
            string "Base Bus Voltage"
            default "236.14f"
        config FLOAT_VALUE_BASE_PHASE_VOLTAGE
            string "Base Phase Voltage"
            default "236.14f"
        config FLOAT_VALUE_BASE_PHASE_CURRENT
            string "Base Phase Current"
            default "10.0f"
        config FLOAT_VALUE_BASE_BUS_CURRENT
            string "Base Bus Current"
            default "7.50f"
    endif # USE_ADC
```

## components/board_support/epwm/Kconfig
```kconfig
menuconfig USE_EPWM
    bool "EPWM"
    default y

    if USE_EPWM
        choice
            default PWM_FREQUENCY_30KHZ
            prompt "PWM Frequency"
            config PWM_FREQUENCY_10KHZ
                bool "10kHz"
            config PWM_FREQUENCY_20KHZ
                bool "20kHz"
            config PWM_FREQUENCY_30KHZ
                bool "30kHz"
        endchoice
        config PWM_FREQ_PRESCALE
            int
            default 1 if PWM_FREQUENCY_10KHZ
            default 2 if PWM_FREQUENCY_20KHZ
            default 3 if PWM_FREQUENCY_30KHZ
        config FLOAT_VALUE_PWM_INT_PERIOD
            string
            default "0.0001f"
        config PWM_DEADBAND
            int "PWM Dead-band (Unit: ns)"
            default 500
    endif # USE_EPWM
```
