## components/board_support/uart/Kconfig
```kconfig
menuconfig USE_UART
    bool "UART"
    default y

    if USE_UART
        menu "UART-A Configuration"
            config ENABLE_UARTA
                bool "UART-A"
                default y

            if ENABLE_UARTA
                choice
                    prompt "TX GPIO"
                    default UARTA_TX_GPIO29
                    config UARTA_TX_GPIO29
                        bool "GPIO29"
                    config UARTA_TX_GPIO35
                        bool "GPIO35"
                endchoice
                config UARTA_TX_GPIO
                    int
                    default 29 if UARTA_TX_GPIO29
                    default 35 if UARTA_TX_GPIO35

                choice
                    prompt "RX GPIO"
                    default UARTA_RX_GPIO28
                    config UARTA_RX_GPIO28
                        bool "GPIO28"
                    config UARTA_RX_GPIO36
                        bool "GPIO36"
                endchoice
                config UARTA_RX_GPIO
                    int
                    default 28 if UARTA_RX_GPIO28
                    default 36 if UARTA_RX_GPIO36

                config BAUDRATE_UARTA
                    int "Baud Rate"
                    default 115200
            endif
        endmenu

        menu "UART-B Configuration"
            config ENABLE_UARTB
                bool "UART-B"
                default n

            if ENABLE_UARTB
                choice
                    prompt "TX GPIO"
                    default UARTB_TX_GPIO18
                    config UARTB_TX_GPIO9
                        bool "GPIO9"
                    config UARTB_TX_GPIO14
                        bool "GPIO14"
                    config UARTB_TX_GPIO18
                        bool "GPIO18"
                    config UARTB_TX_GPIO22
                        bool "GPIO22"
                endchoice
                config UARTB_TX_GPIO
                    int
                    default 9 if UARTB_TX_GPIO9
                    default 14 if UARTB_TX_GPIO14
                    default 18 if UARTB_TX_GPIO18
                    default 22 if UARTB_TX_GPIO22

                choice
                    prompt "RX GPIO"
                    default UARTB_RX_GPIO19
                    config UARTB_RX_GPIO11
                        bool "GPIO11"
                    config UARTB_RX_GPIO15
                        bool "GPIO15"
                    config UARTB_RX_GPIO19
                        bool "GPIO19"
                    config UARTB_RX_GPIO23
                        bool "GPIO23"
                endchoice
                config UARTB_RX_GPIO
                    int
                    default 11 if UARTB_RX_GPIO11
                    default 15 if UARTB_RX_GPIO15
                    default 19 if UARTB_RX_GPIO19
                    default 23 if UARTB_RX_GPIO23

                config BAUDRATE_UARTB
                    int "Baud Rate"
                    default 115200
            endif
        endmenu

        menu "UART-C Configuration"
            config ENABLE_UARTC
                bool "UART-C"
                default n

            if ENABLE_UARTC
                config UARTC_TX_GPIO
                    int
                    default 63
                config UARTC_RX_GPIO
                    int
                    default 62
                config BAUDRATE_UARTC
                    int "Baud Rate"
                    default 115200
            endif
        endmenu

        config TX_QUEUE_BUFF_SZ
            int "Transmit Queue Buffer Size"
            default 256
        config RX_QUEUE_BUFF_SZ
            int "Receive Queue Buffer Size"
            default 128

    endif
```

## controller/configs/controller_defconfig
```kconfig
#
# Components
#

#
# Board Support
#
# CONFIG_CRYSTAL_20MHZ is not set
CONFIG_CRYSTAL_30MHZ=y
CONFIG_CORE_FREQ_150MHZ=y
CONFIG_SYSTEM_FREQ_MHZ=150
CONFIG_USE_UART=y

#
# UART-A Configuration
#
CONFIG_ENABLE_UARTA=y
CONFIG_UARTA_TX_GPIO29=y
# CONFIG_UARTA_TX_GPIO35 is not set
CONFIG_UARTA_TX_GPIO=29
CONFIG_UARTA_RX_GPIO28=y
# CONFIG_UARTA_RX_GPIO36 is not set
CONFIG_UARTA_RX_GPIO=28
CONFIG_BAUDRATE_UARTA=115200
# end of UART-A Configuration

#
# UART-B Configuration
#
# CONFIG_ENABLE_UARTB is not set
# end of UART-B Configuration

#
# UART-C Configuration
#
# CONFIG_ENABLE_UARTC is not set
# end of UART-C Configuration

CONFIG_TX_QUEUE_BUFF_SZ=256
CONFIG_RX_QUEUE_BUFF_SZ=128
CONFIG_USE_EPWM=y
# CONFIG_PWM_FREQUENCY_10KHZ is not set
# CONFIG_PWM_FREQUENCY_20KHZ is not set
CONFIG_PWM_FREQUENCY_30KHZ=y
CONFIG_PWM_FREQ_PRESCALE=3
CONFIG_FLOAT_VALUE_PWM_INT_PERIOD="0.0001f"
CONFIG_PWM_DEADBAND=500
CONFIG_USE_ADC=y

#
# Channel Configuration
#
CONFIG_ADC_IA=11
CONFIG_ADC_IB=13
CONFIG_ADC_IC=5
CONFIG_ADC_VA=15
CONFIG_ADC_VB=14
CONFIG_ADC_VC=12
CONFIG_ADC_VBUS=7
# end of Channel Configuration

CONFIG_FLOAT_VALUE_BASE_BUS_VOLTAGE="236.14f"
CONFIG_FLOAT_VALUE_BASE_PHASE_VOLTAGE="236.14f"
CONFIG_FLOAT_VALUE_BASE_PHASE_CURRENT="10.0f"
CONFIG_FLOAT_VALUE_BASE_BUS_CURRENT="7.50f"
# end of Board Support

CONFIG_USE_CANOPEN=y

#
# Task Property
#

#
# CO main
#
CONFIG_CANOPEN_MAIN_TASK_PRIORITY=1
CONFIG_CANOPEN_MAIN_TASK_STACK=640
CONFIG_CANOPEN_MAIN_INTERVAL_MS=10
# end of CO main

#
# CO timer
#
CONFIG_CANOPEN_TIMER_TASK_PRIORITY=2
CONFIG_CANOPEN_TIMER_TASK_STACK=512
CONFIG_CANOPEN_TIMER_INTERVAL_MS=5
# end of CO timer
# end of Task Property

#
# CAN Configurtion
#
CONFIG_CANOPEN_USE_CAN_A=y
# CONFIG_CANOPEN_USE_CAN_B is not set
# CONFIG_CANOPEN_TX_GPIO19 is not set
CONFIG_CANOPEN_TX_GPIO31=y
# CONFIG_CANOPEN_RX_GPIO18 is not set
CONFIG_CANOPEN_RX_GPIO30=y

#
# Supported Bit Rate
#
CONFIG_CANOPEN_BITRATE_20KBPS=y
CONFIG_CANOPEN_BITRATE_50KBPS=y
CONFIG_CANOPEN_BITRATE_125KBPS=y
CONFIG_CANOPEN_BITRATE_250KBPS=y
CONFIG_CANOPEN_BITRATE_500KBPS=y
CONFIG_CANOPEN_BITRATE_1000KBPS=y
# end of Supported Bit Rate

# CONFIG_CANOPEN_DEFAULT_BITRATE_20KBPS is not set
# CONFIG_CANOPEN_DEFAULT_BITRATE_50KBPS is not set
# CONFIG_CANOPEN_DEFAULT_BITRATE_125KBPS is not set
# CONFIG_CANOPEN_DEFAULT_BITRATE_250KBPS is not set
# CONFIG_CANOPEN_DEFAULT_BITRATE_500KBPS is not set
CONFIG_CANOPEN_DEFAULT_BITRATE_1000KBPS=y
CONFIG_CANOPEN_DEFAULT_BITRATE=1000
# end of CAN Configurtion

#
# CANopen Configuration
#
CONFIG_CANOPEN_DEFAULT_NODEID=0x01
CONFIG_CANOPEN_LSS_SLAVE_ENABLE=y
CONFIG_CANOPEN_TIME_ENABLE=y
# CONFIG_CANOPEN_TIME_PRODUCER is not set
CONFIG_CANOPEN_SYNC_ENABLE=y
# CONFIG_CANOPEN_SYNC_PRODUCER is not set
CONFIG_CANOPEN_FIRST_HB_TIME=500
CONFIG_CANOPEN_SDO_SRV_TIMEOUT=1000
CONFIG_CANOPEN_SDO_CLIENT_TIMEOUT=500
# end of CANopen Configuration

#
# QPC Configuration
#

#
# Memory Pool
#

#
# Small Memory Pool
#
CONFIG_QPC_SMALL_MEMPOOL_ENTRY_COUNT=32
# end of Small Memory Pool

#
# Medium Memory Pool
#
CONFIG_QPC_MEDIUM_MEMPOOL_ENTRY_SIZE=16
CONFIG_QPC_MEDIUM_MEMPOOL_ENTRY_COUNT=32
# end of Medium Memory Pool

#
# Large Memory Pool
#
CONFIG_QPC_LARGE_MEMPOOL_ENTRY_SIZE=64
CONFIG_QPC_LARGE_MEMPOOL_ENTRY_COUNT=32
# end of Large Memory Pool
# end of Memory Pool

CONFIG_QPC_QSPY_ENABLE=y
CONFIG_QSPY_USE_UART_A=y
CONFIG_QPSY_WORKER_TASK_PRIORITY=1
CONFIG_QSPY_WORKER_STACK_SIZE=512
CONFIG_QSPY_TX_BUFFER_SIZE=256
CONFIG_QSPY_RX_BUFFER_SIZE=256
CONFIG_QSPY_RX_TIMEOUT_MS=2
# end of QPC Configuration
# end of Components
```
